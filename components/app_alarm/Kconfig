## components/app_alarm/Kconfig
```kconfig
menu "Grok desk buddy alarms"

    config GROK_BUDDY_TZ
        string "Time zone (POSIX TZ)"
        default "UTC0"
        help
            Local time for alarms, e.g. "CST6CDT,M3.2.0,M11.1.0" (US Central)
            or "PST8PDT,M3.2.0,M11.1.0". Put personal values in the git-ignored
            sdkconfig.local.defaults.

endmenu
```

## components/app_voice/Kconfig
```kconfig
menu "Grok desk buddy"

    config GROK_BUDDY_OWNER_NAME
        string "Owner's name"
        default "the user"
        help
            How the voice refers to the person at the desk, e.g. "Sam".
            Put personal values in the git-ignored sdkconfig.local.defaults.

    config GROK_BUDDY_BOT_NAME
        string "Grok Bot name"
        default "Bob"
        help
            Name of the personal Grok Bot that receives hand-off tasks
            through the relay (see relay/README.md).

endmenu
```
